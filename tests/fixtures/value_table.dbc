VERSION ""

NS_ :

BS_:

BU_: ECU1

BO_ 896 TestMsg380: 8 ECU1
 SG_ StateEnum : 0|8@1+ (1,0) [0|255] "" Vector__XXX
 SG_ RawValue : 8|16@1+ (1,0) [0|65535] "units" Vector__XXX

VAL_ 896 StateEnum 0 "OFF" 1 "ON" 2 "FAULT" ;
