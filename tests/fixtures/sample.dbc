VERSION ""

NS_ :

BS_:

BU_: ECU1

BO_ 100 EngineData: 8 ECU1
 SG_ RPM : 0|16@1+ (1,0) [0|8000] "rpm" Vector__XXX
 SG_ Temp : 16|8@1+ (1,-40) [-40|215] "C" Vector__XXX
